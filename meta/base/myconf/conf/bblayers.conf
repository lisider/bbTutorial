## meta/base/myconf/conf/bblayers.conf
```bitbake
BBPATH := "${TOPDIR}"
BBFILES ?= ""
BBLAYERS = "${BBPATH}/../meta/meta-tutorial"
#BBLAYERS += "${BBPATH}/../meta/meta-two"
#BBLAYERS += "${BBPATH}/../meta/meta-testclass"
```

## meta/meta-two/conf/layer.conf
```bitbake
BBPATH .= ":${LAYERDIR}"  #用来搜索 conf  和 class 中的配置文件 和 类文件
BBFILES += "${LAYERDIR}/recipes-*/*/*.bb" # 用来搜索 bb 文件 和 bbappend 文件
# append layer name to list of configured layers                                                       
BBFILE_COLLECTIONS += "two"                                                                       
# and use name as suffix for other properties                                                          
BBFILE_PATTERN_two = "^${LAYERDIR}/"                                                              
BBFILE_PRIORITY_two = "1"

BBFILES += "${LAYERDIR}/recipes-*/*/*.bbappend"
```
